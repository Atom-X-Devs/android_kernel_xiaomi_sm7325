&mdss_mdp {
	dsi_m20_42_0d_0b_dsc_vid: qcom,mdss_dsi_m20_42_0d_0b_dsc_vid {
		qcom,mdss-dsi-panel-name = "xiaomi 42 0d 0b video mode dsc dsi panel";
		qcom,mdss-dsi-panel-type = "dsi_video_mode";
		qcom,mdss-dsi-virtual-channel-id = <0>;
		qcom,mdss-dsi-stream = <0>;
		qcom,mdss-dsi-bpp = <30>;
		qcom,mdss-dsi-color-order = "rgb_swap_rgb";
		qcom,mdss-dsi-underflow-color = <0xff>;
		qcom,mdss-dsi-border-color = <0>;
		qcom,dsi-ctrl-num = <0>;
		qcom,dsi-phy-num = <0>;
		qcom,mdss-dsi-traffic-mode = "burst_mode";
		qcom,mdss-dsi-lane-map = "lane_map_0123";
		qcom,mdss-dsi-bllp-eof-power-mode;
		qcom,mdss-dsi-bllp-power-mode;
		qcom,mdss-dsi-lane-0-state;
		qcom,mdss-dsi-lane-1-state;
		qcom,mdss-dsi-lane-2-state;
		qcom,mdss-dsi-lane-3-state;
		qcom,mdss-dsi-dma-trigger = "trigger_sw";
		qcom,mdss-dsi-mdp-trigger = "none";
		qcom,mdss-dsi-reset-sequence =  <1 1>, <0 1>, <1 20>;
		qcom,mdss-pan-physical-width-dimension = <70>;
		qcom,mdss-pan-physical-height-dimension = <154>;
		qcom,mdss-dsi-tx-eot-append;
		qcom,mdss-dsi-lp11-init;
		qcom,mdss-dsi-bl-inverted-dbv;
		qcom,bl-update-flag = "delay_until_first_frame";
		qcom,mdss-dsi-phy-voltage = <0x51>;

		qcom,mdss-dsi-panel-hdr-enabled;
		qcom,mdss-dsi-panel-hdr-color-primaries =
			<14500 15500 32000 17000 15500 30000 8000 3000>;
		qcom,mdss-dsi-panel-peak-brightness = <4200000>;
		qcom,mdss-dsi-panel-blackness-level = <3230>;
		qcom,mdss-dsi-pan-enable-dynamic-fps;
		qcom,mdss-dsi-pan-fps-update = "dfps_immediate_porch_mode_vfp";
		qcom,dsi-supported-dfps-list = <120 60>;

		qcom,mdss-dsi-display-timings {
			timing@0 {
				qcom,mdss-dsi-panel-framerate = <120>;
				qcom,mdss-dsi-panel-width = <1080>;
				qcom,mdss-dsi-panel-height = <2400>;
				qcom,mdss-dsi-h-front-porch = <48>;
				qcom,mdss-dsi-h-back-porch = <64>;
				qcom,mdss-dsi-h-pulse-width = <4>;
				qcom,mdss-dsi-h-sync-skew = <0>;
				qcom,mdss-dsi-v-back-porch = <8>;
				qcom,mdss-dsi-v-front-porch = <20>;
				qcom,mdss-dsi-v-pulse-width = <4>;
				qcom,mdss-dsi-h-sync-pulse = <0>;
				qcom,mdss-dsi-h-left-border = <0>;
				qcom,mdss-dsi-h-right-border = <0>;
				qcom,mdss-dsi-v-top-border = <0>;
				qcom,mdss-dsi-v-bottom-border = <0>;

				qcom,mdss-dsi-on-command = [
					15 01 00 00 00 00 02 53 20
					39 01 00 00 00 00 03 51 00 00
					15 01 00 00 00 00 02 6F 01
					15 01 00 00 00 00 02 03 01
					15 01 00 00 00 00 02 35 00
					15 01 00 00 00 00 02 6C 02
					39 01 00 00 00 00 5F 70 12 00 00 AB 30 80 09 60 04 38 00 0C 02 1C 02 1C 02 00 02 0E 00 20 01 1F 00 07 00 0C 08 BB 08 7A 18 00 10 F0 07 10 20 00 06 0F 0F 33 0E 1C 2A 38 46 54 62 69 70 77 79 7B 7D 7E 02 02 22 00 2A 40 2A BE 3A FC 3A FA 3A F8 3B 38 3B 78 43 B6 4B B6 4B F6 4B F4 64 34 84 74 00 00 00 00 00 00
					15 01 00 00 00 00 02 59 09
					39 01 00 00 00 00 03 F0 AA 10
					15 01 00 00 00 00 02 65 04
					15 01 00 00 00 00 02 CF 7F
					39 01 00 00 00 00 03 F0 AA 18
					15 01 00 00 00 00 02 B0 13
					15 01 00 00 00 00 02 B2 13
					39 01 00 00 00 00 03 FF 5A 81
					15 01 00 00 00 00 02 65 03
					15 01 00 00 00 00 02 F4 03
					15 01 00 00 00 00 02 65 08
					39 01 00 00 00 00 03 F6 51 44
					39 01 00 00 00 00 03 F0 AA 13
					15 01 00 00 00 00 02 C8 04
					15 01 00 00 00 00 02 D0 04
					15 01 00 00 00 00 02 E0 04
					39 01 00 00 00 00 03 FF 5A 80
					15 01 00 00 00 00 02 65 0E
					15 01 00 00 00 00 02 F9 B9
					15 01 00 00 00 00 02 55 00
					39 01 00 00 00 00 03 F0 AA 11
					39 01 00 00 00 00 03 BA 82 10
					15 01 00 00 00 00 02 65 01
					15 01 00 00 00 00 02 B0 81
					15 01 00 00 00 00 02 57 00
					39 01 00 00 00 00 03 F0 AA 19
					39 01 00 00 00 00 31 D1 00 04 04 06 07 08 08 09 00 FE FC FA FA F9 F7 F7 00 04 04 06 07 08 08 09 00 FE FC FA FA F9 F7 F7 00 04 04 06 07 08 08 09 00 FE FC FA FA F9 F7 F7
					39 01 00 00 00 00 31 D2 00 04 04 07 07 09 09 0A 00 FC FC FA FA F9 F7 F7 00 04 04 07 07 09 09 0A 00 FC FC FA FA F9 F7 F7 00 04 04 07 07 09 09 0A 00 FC FC FA FA F9 F7 F7
					39 01 00 00 00 00 31 D4 00 00 00 00 00 FF FF FF 00 01 01 01 02 02 03 03 00 00 00 00 00 FF FF FF 00 01 01 01 02 02 03 03 00 00 00 00 00 FF FF FF 00 01 01 01 02 02 03 03
					39 01 00 00 00 00 31 D5 00 FE FE FE FF FF FF FF 00 01 01 01 02 02 03 03 00 FE FE FE FF FF FF FF 00 01 01 01 02 02 03 03 00 FE FE FE FF FF FF FF 00 01 01 01 02 02 03 03
					39 01 00 00 00 00 31 D6 00 03 02 02 01 00 00 00 00 00 FF FF 00 00 00 00 00 03 02 02 01 00 00 00 00 00 FF FF 00 00 00 00 00 03 02 02 01 00 00 00 00 00 FF FF 00 00 00 00
					39 01 00 00 00 00 03 F0 AA 10
					39 01 00 00 00 00 03 D0 84 35
					39 01 00 00 00 00 03 FF 5A 00
					39 01 00 00 00 00 03 F0 AA 00
					05 01 00 00 78 00 01 11
					05 01 00 00 00 00 01 29
				];

				qcom,mdss-dsi-off-command = [
					15 01 00 00 0A 00 02 28 00
					15 01 00 00 78 00 02 10 00
				];
				qcom,mdss-dsi-on-command-state = "dsi_lp_mode";
				qcom,mdss-dsi-off-command-state = "dsi_lp_mode";

				qcom,mdss-dsi-lp1-command = [ ];
				qcom,mdss-dsi-lp1-commandd-state = "dsi_hs_mode";

				qcom,mdss-dsi-nolp-command = [ ];
				qcom,mdss-dsi-nolp-command-state = "dsi_hs_mode";

				qcom,compression-mode = "dsc";
				qcom,mdss-dsc-version = <0x12>;
				qcom,mdss-dsc-scr-version = <0x0>;
				qcom,mdss-dsc-slice-height = <12>;
				qcom,mdss-dsc-slice-width = <540>;
				qcom,mdss-dsc-slice-per-pkt = <2>;
				qcom,mdss-dsc-bit-per-component = <10>;
				qcom,mdss-dsc-bit-per-pixel = <8>;
				qcom,mdss-dsc-block-prediction-enable;
			};

		};
	};
};

&dsi_m20_42_0d_0b_dsc_vid {
	qcom,mdss-dsi-display-timings {
		timing@0{
			mi,mdss-dsc-panel-id = <0x004D3230 0x00420D00>;

			mi,mdss-dsi-hbm-on-command = [
				39 01 00 00 00 00 03 51 0F FF
			];
			mi,mdss-dsi-hbm-on-command-state = "dsi_hs_mode";

			mi,mdss-dsi-hbm-off-command = [
				39 01 00 00 00 00 03 51 07 FF
			];
			mi,mdss-dsi-hbm-off-command-state = "dsi_hs_mode";

			mi,mdss-dsi-doze-hbm-command = [
				39 01 00 00 00 00 07 51 00 F5 07 FF 03 FF
			];
			mi,mdss-dsi-doze-hbm-command-state = "dsi_hs_mode";

			mi,mdss-dsi-doze-lbm-command = [
				39 01 00 00 00 00 07 51 00 14 07 FF 01 FF
			];
			mi,mdss-dsi-doze-lbm-command-state = "dsi_hs_mode";

			mi,mdss-dsi-doze-hbm-nolp-command = [
				39 01 00 00 00 00 07 51 00 F5 07 FF 03 FF
			];
			mi,mdss-dsi-doze-hbm-nolp-command-state = "dsi_hs_mode";

			mi,mdss-dsi-doze-lbm-nolp-command = [
				39 01 00 00 00 00 07 51 00 14 07 FF 01 FF
			];
			mi,mdss-dsi-doze-lbm-nolp-command-state = "dsi_hs_mode";

			mi,mdss-dsi-fps-120-gamma-command = [
				15 01 00 00 00 00 02 6C 02
			];
			mi,mdss-dsi-fps-120-gamma-command-state = "dsi_lp_mode";

			mi,mdss-dsi-fps-60-gamma-command = [
				15 01 00 00 00 00 02 6C 00
			];
			mi,mdss-dsi-fps-60-gamma-command-state = "dsi_lp_mode";
		};

	};
};
