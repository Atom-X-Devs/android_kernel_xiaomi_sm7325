## arch/arm64/Kconfig.debug
```kconfig
# SPDX-License-Identifier: GPL-2.0-only

config ARM64_PTDUMP_CORE
	def_bool n

config ARM64_PTDUMP_DEBUGFS
	bool "Export kernel pagetable layout to userspace via debugfs"
	depends on DEBUG_KERNEL
	select ARM64_PTDUMP_CORE
	select DEBUG_FS
        help
	  Say Y here if you want to show the kernel pagetable layout in a
	  debugfs file. This information is only useful for kernel developers
	  who are working in architecture specific areas of the kernel.
	  It is probably not a good idea to enable this feature in a production
	  kernel.

	  If in doubt, say N.

config PID_IN_CONTEXTIDR
	bool "Write the current PID to the CONTEXTIDR register"
	help
	  Enabling this option causes the kernel to write the current PID to
	  the CONTEXTIDR register, at the expense of some additional
	  instructions during context switch. Say Y here only if you are
	  planning to use hardware trace tools with this kernel.

config DEBUG_WX
	bool "Warn on W+X mappings at boot"
	select ARM64_PTDUMP_CORE
	---help---
	  Generate a warning if any W+X mappings are found at boot.

	  This is useful for discovering cases where the kernel is leaving
	  W+X mappings after applying NX, as such mappings are a security risk.
	  This check also includes UXN, which should be set on all kernel
	  mappings.

	  Look for a message in dmesg output like this:

	    arm64/mm: Checked W+X mappings: passed, no W+X pages found.

	  or like this, if the check failed:

	    arm64/mm: Checked W+X mappings: FAILED, <N> W+X pages found.

	  Note that even if the check fails, your kernel is possibly
	  still fine, as W+X mappings are not a security hole in
	  themselves, what they do is that they make the exploitation
	  of other unfixed kernel bugs easier.

	  There is no runtime or memory usage effect of this option
	  once the kernel has booted up - it's a one time check.

	  If in doubt, say "Y".

config DEBUG_EFI
	depends on EFI && DEBUG_INFO
	bool "UEFI debugging"
	help
	  Enable this option to include EFI specific debugging features into
	  the kernel that are only useful when using a debug build of the
	  UEFI firmware

config ARM64_RELOC_TEST
	depends on m
	tristate "Relocation testing module"

source "drivers/hwtracing/coresight/Kconfig"
```

## drivers/input/fingerprint/fpc/Kconfig
```kconfig
#
# SPDX-License-Identifier: GPL-2.0-only
#

config FINGERPRINT_FPC
	tristate "Finger print card fpc"
	depends on INPUT_FINGERPRINT
	help
	  Say Y here to enable support for fpc fingerprint cards.

	  If unsure, say N.

	  To compile this driver as a module, choose M here.
```

## drivers/input/fingerprint/goodix_tee/Kconfig
```kconfig
#
# SPDX-License-Identifier: GPL-2.0-only
#

config FINGERPRINT_GOODIX_TEE
	tristate "Finger print card goodix"
	depends on INPUT_FINGERPRINT
	help
	  Say Y here to enable support for Goodix fingerprint cards.

	  If unsure, say N.

	  To compile this driver as a module, choose M here.
```

## drivers/input/fingerprint/xiaomi_fp/Kconfig
```kconfig
#
# SPDX-License-Identifier: GPL-2.0-only
#

config FINGERPRINT_XIAOMI_FP
	tristate "Finger print card xiaomi_fp"
	depends on INPUT_FINGERPRINT
	help
	  Say Y here to enable support for Xiaomi fingerprint cards.

	  If unsure, say N.

	  To compile this driver as a module, choose M here.
```

## drivers/input/touchscreen/gt9897t/Kconfig
```kconfig
# SPDX-License-Identifier: GPL-2.0

#
# Goodix touchscreen driver configuration
#
menuconfig TOUCHSCREEN_GOODIX_BRL
	tristate "Goodix berlin touchscreen"
	depends on SPI_MASTER
	help
	  Say Y here if you have a Goodix berlin series touch
	  controller connected via SPI bus to your system.

	  If unsure, say N.

	  To compile this driver as a module, choose M here.

config TOUCHSCREEN_GOODIX_BRL_QGKI
	bool "Goodix QGKI interface support"
	depends on TOUCHSCREEN_GOODIX_BRL
	help
	  Say Y here to enable goodix panel's QGKI interface.

	  If unsure, say N.

config TOUCHSCREEN_GOODIX_BRL_TOOLS
	tristate "Goodix debug tools support"
	depends on TOUCHSCREEN_GOODIX_BRL
	help
	  Say Y here to enable debug tools

	  If unsure, say N.

	  To compile this driver as a module, choose M here.

config TOUCHSCREEN_GOODIX_BRL_GESTURE
	tristate "Goodix gesture support"
	depends on TOUCHSCREEN_GOODIX_BRL
	help
	  Say Y to enable gesture

	  If unsure, say N.

	  To compile this driver as a module, choose M here.
```

## drivers/input/touchscreen/gt9916_m20/Kconfig
```kconfig
#
# Goodix touchscreen driver configuration
#
menuconfig TOUCHSCREEN_GOODIX_BRL
	tristate "Goodix berlin touchscreen"
	help
	  Say Y here if you have a Goodix berlin series touch controller
	  to your system.

	  If build module, say M.
	  If unsure, say N.

if TOUCHSCREEN_GOODIX_BRL

config TOUCHSCREEN_GOODIX_BRL_SPI
	bool "support SPI bus connection"
	default y
	help
		Say Y here if the touchscreen is connected via SPI bus.

config TOUCHSCREEN_GOODIX_BRL_QGKI
	bool "Goodix berlin touchscreen qgki"
	default y if QGKI
	help
		Goodix berlin touchscreen qgki.

endif
```

## drivers/platform/xiaomi/Kconfig
```kconfig
menu "Xiaomi board selection"

config MACH_XIAOMI
	bool "Support for Xiaomi products"
	depends on ARCH_QCOM
	help
	  Support for Xiaomi products.

config MACH_XIAOMI_SM7325
	bool "Support for Xiaomi SM7325 (Yupik) platform devices."
	depends on ARCH_YUPIK
	select MACH_XIAOMI
	help
	  Support for Xiaomi SM7325 (Yupik) platform devices.

config MACH_XIAOMI_LISA
	bool "Support for Xiaomi 11 lite 5G NE (lisa) board"
	select MACH_XIAOMI_SM7325
	help
	  Support for Xiaomi 11 lite 5G NE (lisa) board.

config MACH_XIAOMI_REDWOOD
	bool "Support for Poco X5 PRO 5G (redwood) board"
	select MACH_XIAOMI_SM7325
	help
	  Support for Poco X5 PRO 5G (redwood) board.

endmenu
```
